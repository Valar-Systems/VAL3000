## firmware/VAL3000-matter-esp-idf/managed_components/espressif__esp_secure_cert_mgr/Kconfig
```kconfig
menu "ESP Secure Cert Manager"

    config ESP_SECURE_CERT_DS_PERIPHERAL
        bool "Enable DS peripheral support"
        default y
        depends on SOC_DIG_SIGN_SUPPORTED
        select MBEDTLS_HARDWARE_RSA_DS_PERIPHERAL
        help
            Enable the RSA DS peripheral support. Not supported on targets that do not support Digital Signature peripheral

    config ESP_SECURE_CERT_SUPPORT_LEGACY_FORMATS
        bool "Enable support for legacy formats"
        default n
        help
            This option enables support for the legacy formats along with
            the current format in the esp_secure_cert component.
            The current format is
            cust_flash_tlv
            The legacy formats are as follows:
            cust_flash
            nvs

    config ESP_SECURE_CERT_SECURE_VERIFICATION
        bool "Enable secure verification support"
        default n
        depends on SECURE_BOOT_V2_RSA_ENABLED || SECURE_BOOT_V2_ECDSA_ENABLED
        help
            Enable support for secure verification for esp_secure_cert partition which relies on secure boot v2. Once enabled, the esp_secure_cert partition can be securely verified by calling esp_secure_cert_verify_partition() just after startup.

    config ESP_SECURE_CERT_WRITE_ENABLE_LOGGING
        bool "Enable verbose logging for write operations"
        default n
        help
            Enable detailed logging for ESP Secure Cert write operations.
            When disabled, only error logs are printed to reduce binary size.
            Info, debug, and warning logs are suppressed when this option
            is disabled, which can significantly reduce flash usage.
            This is recommended for production builds since write operations
            typically occur only once during device lifetime.

endmenu # ESP Secure Cert Manager
```

## firmware/VAL3000-matter-esp-idf/managed_components/espressif__esp_secure_cert_mgr/examples/esp_secure_cert_app/main/Kconfig.projbuild
```kconfig
menu "Example Configuration"

config EXAMPLE_ESP_SECURE_CERT_ENABLE_CI
    bool
    default n
    help
        Enable this option to apply configuration settings required for running
        the esp_secure_cert example in Continuous Integration (CI) environments.
        This may include settings for automated testing, mock data, or other
        CI-specific behaviors. It is not intended for production use.

config EXAMPLE_ESP_SECURE_CERT_WRITE_DEMO
    bool "Enable write functionality demo"
    default n
    help
        Enable this option to run a simple write functionality demonstration.
        This shows how to use esp_secure_cert_append_tlv() to write custom
        user data to the esp_secure_cert partition.

        WARNING: This will erase and modify the esp_secure_cert partition!
        Only enable for testing or on devices without production credentials.

endmenu
```

## firmware/VAL3000-matter-esp-idf/managed_components/espressif__esp_secure_cert_mgr/examples/esp_secure_cert_app/sdkconfig.defaults.esp32
```kconfig
CONFIG_ESP32_REV_MIN_3=y
CONFIG_ESP32_REV_MIN=3
CONFIG_ESP_SECURE_CERT_SECURE_VERIFICATION=y
CONFIG_SECURE_BOOT=y
CONFIG_EXAMPLE_ESP_SECURE_CERT_ENABLE_CI=y
CONFIG_ESP_SECURE_CERT_SUPPORT_LEGACY_FORMATS=n
CONFIG_ESP_SECURE_CERT_DS_PERIPHERAL=y
```

## firmware/VAL3000-matter-esp-idf/managed_components/espressif__esp_secure_cert_mgr/test_apps/main/Kconfig.projbuild
```kconfig
menu "Test Apps Configuration"

    config TEST_ESP_SECURE_CERT_TLV_LEGACY
        bool "Test TLV and legacy format operations"
        default n
        help
            Enable this option to test the TLV and legacy format operations

    config TEST_ESP_SECURE_CERT_CRYPTO
        bool "Test cryptographic operations"
        default n
        help
            Enable this option to test the cryptographic operations

    config TEST_ESP_SECURE_CERT_BASICS
        bool "Test basic operations"
        default n
        help
            Enable this option to test the basic operations

    config UNITY_FREERTOS_STACK_SIZE
        int "Stack size for the test task"
        default 8192
        help
            Set the stack size for the test task

    config TEST_ESP_SECURE_CERT_SECURE_VERIFICATION
        bool "Test secure verification operations"
        default n
        help
            Enable this option to test the secure verification operations

    config TEST_APP_SECURE_VERIFICATION_CORRUPT_PARTITION
        bool "Test secure verification operations with corrupt secure cert partition"
        default n
        help
            Enable this option to test the secure verification operations with corrupt secure cert partition.

    config TEST_ESP_SECURE_CERT_WRITE
        bool "Test write operations"
        default n
        help
            Enable this option to test the write operations for esp_secure_cert partition.
            This includes testing TLV write, batch write, buffer mode write, and error handling.

endmenu
```

## firmware/VAL3000-matter-esp-idf/managed_components/espressif__esp_secure_cert_mgr/test_apps/sdkconfig.defaults
```kconfig
# ESP Secure Cert TLV Test Application Configuration
CONFIG_ESP_TASK_WDT_EN=n

# Partition table configuration (matching esp_secure_cert_app)
CONFIG_PARTITION_TABLE_CUSTOM=y
CONFIG_PARTITION_TABLE_OFFSET=0xc000
CONFIG_PARTITION_TABLE_CUSTOM_FILENAME="qemu_test/cust_flash_tlv/partitions.csv"

# Flash size configuration for QEMU testing
CONFIG_ESPTOOLPY_FLASHSIZE_2MB=y
CONFIG_ESPTOOLPY_FLASHSIZE="2MB"

# Logging configuration
CONFIG_LOG_DEFAULT_LEVEL_INFO=y
CONFIG_LOG_MAXIMUM_LEVEL=3

# Main task configuration
CONFIG_ESP_MAIN_TASK_STACK_SIZE=8192

# Unity test framework configuration
CONFIG_UNITY_ENABLE_FIXTURE=y
CONFIG_UNITY_FREERTOS_STACK_SIZE=8192
```

## firmware/VAL3000-matter-esp-idf/sdkconfig.defaults
```kconfig
# Set target to ESP32-C3
CONFIG_IDF_TARGET="esp32c3"

# Default to 921600 baud when flashing and monitoring device
CONFIG_ESPTOOLPY_BAUD_921600B=y
CONFIG_ESPTOOLPY_BAUD=921600
CONFIG_ESPTOOLPY_COMPRESSED=y
CONFIG_ESPTOOLPY_MONITOR_BAUD_115200B=y
CONFIG_ESPTOOLPY_MONITOR_BAUD=115200
CONFIG_ESPTOOLPY_FLASHSIZE_4MB=y

#enable BT
CONFIG_BT_ENABLED=y
CONFIG_BT_NIMBLE_ENABLED=y
CONFIG_USE_BLE_ONLY_FOR_COMMISSIONING=y

#disable BT connection reattempt
CONFIG_BT_NIMBLE_ENABLE_CONN_REATTEMPT=n

#enable lwip ipv6 autoconfig
CONFIG_LWIP_IPV6_AUTOCONFIG=y

# Use a custom partition table
CONFIG_PARTITION_TABLE_CUSTOM=y
CONFIG_PARTITION_TABLE_FILENAME="partitions.csv"
CONFIG_PARTITION_TABLE_OFFSET=0xC000

# Enable chip shell
CONFIG_ENABLE_CHIP_SHELL=n

#enable lwIP route hooks
CONFIG_LWIP_HOOK_IP6_ROUTE_DEFAULT=y
CONFIG_LWIP_HOOK_ND6_GET_GW_DEFAULT=y

# Button
CONFIG_BUTTON_PERIOD_TIME_MS=20
CONFIG_BUTTON_LONG_PRESS_TIME_MS=5000

# disable softap by default
CONFIG_ESP_WIFI_SOFTAP_SUPPORT=n

# Disable DS Peripheral
CONFIG_ESP_SECURE_CERT_DS_PERIPHERAL=n

# Use compact attribute storage mode
CONFIG_ESP_MATTER_NVS_USE_COMPACT_ATTR_STORAGE=y

# Enable HKDF in mbedtls
CONFIG_MBEDTLS_HKDF_C=y

# UART IRAM Configuration
CONFIG_UART_ISR_IN_IRAM=y

# GPIO IRAM Configuration
CONFIG_GPIO_CTRL_FUNC_IN_IRAM=y

# GPTimer Configuration
CONFIG_GPTIMER_ISR_HANDLER_IN_IRAM=y
```
